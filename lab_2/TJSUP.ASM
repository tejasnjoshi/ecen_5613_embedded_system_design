	ORG	$0000
	LJMP	MAIN


	ORG	$0040	
MAIN	MOV	TMOD,#01H	; SET TIMER 0 TO MODE 1
	MOV	R1,#000H	; INITIALIZE R1 TO 00H
	MOV	R0,#080H	; INITIALIZE R0 TO 80H
	MOV	DPTR,#0H	; INITIALIZE DPTR TO 0000H	
D2	MOV	TH0,#05FH	; LOAD TIMER0 (HI8) WITH 00H
	MOV	TL0,#0FFH	; LOAD TIMER0 (LO8) WITH 00H
	MOV	IE,#082H	; SET THE INTERUUPT MASK BITS
	MOV	A,R1		; MOVE DATA FROM R1
	MOVX	[DPTR],A	; WRITE DATA TO EXTERNAL MEMORY
	INC	R1		; INCREMENT R1( 00h -7Fh)
	MOV	A,R1		; CHEKCK IF 
	SUBB	A,#7EH		; COUNT HAS REACHED 7F
	JNZ	D3		; IF R1==7F THEN
	MOV	R1,#0FFH	; RELOAD R1 WITH 00
	MOV 	R0,#07FH
D3	SETB	TCON.4		; START TIMER	
	JNB	TCON.5,$	; LOOP HERE
	SJMP	D2		; INFINITE LOOP



	ORG	$000B
ISR	MOV	IE,#00H		; SET INTERRUPT MASK REGISTER
	MOV	TCON,#00H	; SET TCON REGISTERS
	MOV	A,R0		; LOAD TO A FOR WRITING
	MOVX	[DPTR],A	; WRITING DATA TO EXTERNAL MEMORY
	INC	R0		; INCREMENT R0 (80h-FFh)
	RETI